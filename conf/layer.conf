## conf/layer.conf
```bitbake
# We have a conf and classes directory, add to BBPATH
BBPATH .= ":${LAYERDIR}"

# We have a packages directory, add to BBFILES
BBFILES += " \
		${LAYERDIR}/recipes-*/*/*.bb \
		${LAYERDIR}/recipes-*/*/*.bbappend"

BBFILES_DYNAMIC += " \
    petalinux:${LAYERDIR}/dynamic-layers/petalinux/recipes-*/*/*.bb \
    petalinux:${LAYERDIR}/dynamic-layers/petalinux/recipes-*/*/*.bbappend \
"

BBFILE_COLLECTIONS += "xilinx-tsn"
BBFILE_PATTERN_xilinx-tsn = "^${LAYERDIR}/"
BBFILE_PRIORITY_xilinx-tsn = "6"

LAYERSUMMARY_xilinx-tsn = "AMD Xilinx Time-Sensitive Networking \
endpoint utilities"
LAYERDESCRIPTION_xilinx-tsn = "Recipes and packagegroup for the AMD \
Xilinx Time-Sensitive Networking (TSN) endpoint stack: gPTP, \
tsn-utils, packeth, and example applications."

LAYERDEPENDS_xilinx-tsn = "\
    core \
    openembedded-layer \
    xilinx \
    "

LAYERSERIES_COMPAT_xilinx-tsn = "scarthgap"
```
